## drivers/input/ti-sensor/Kconfig
```kconfig
#
# TI's shared transport line discipline and the protocol
# drivers (BT, FM and GPS)
#
menu "Texas Gyro and Accel sensor"
config TI_ST_GYRO_330D
   tristate "gyro 330d"
   depends on I2C
   help 
      if you say yes here, you just support st gyro 330d
config TI_ST_ACC_330D
   tristate "acc 330d"
   depends on I2C
   help 
      if you say yes here, you just support st gyro 330d
config TAOS_ALS
   tristate "taos light sensor"
   depends on I2C
   help
     if you say yes here, you just support taos als
config TAOS_27723
   tristate "taos light sensor"
   depends on I2C
   help
     if you say yes here, you just support taos tmd27723
 config SENSORS_AK8963
 	tristate "AK8963 compass support"
	default n
	depends on I2C
	help
	  If you say yes here you get support for Asahi Kasei's
	  orientation sensor AK8963.
	  
endmenu
```
